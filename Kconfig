## Kconfig
```kconfig
mainmenu "External Modules"

config MODULES
	def_bool y
	option modules

source "drivers/Kconfig"
```

## drivers/net/dsa/pasw/Kconfig
```kconfig
config NET_DSA_PASW
	tristate "Packet Architects FlexSwitch"
	depends on m
	help
	  DSA driver for the FlexSwitch switch core from Packet
	  Architects.
```

## drivers/net/ethernet/xdma-net/Kconfig
```kconfig
config NET_ETH_XDMA_NET
	tristate "AMD/Xilinx XDMA net device"
	depends on m
	help
	  Uses an instance of Xilinx's XDMA block to implement a
	  standard Linux net device. Southbound channels must be
	  attached to AXI stream interfaces, over which Ethernet
	  frames are transported.

	  In contrast to the upstream driver for this core
	  (`drivers/dma/xilinx/xdma.c`), the "Credit Mode" is used to
	  operate the engine with a ring of descriptors, which is much
	  more natural to the kernel's networking API since most NICs
	  operate in this manner.
```

## drivers/ptp/pg210-ptp/Kconfig
```kconfig
config PTP_PG210_PTP
	tristate "Xilinx PG210 Timer Syncer"
	depends on m
	help
	  PHC driver for the Timer Syncer block described in AMD's PG210.
```
